## app/hello_rv/Config.in
```kconfig
menuconfig RV_TARGET_HELLO_RV
	bool "hello rv"
	default n
	help
	  never set y, as the module's goal is showing how to write rvmk and Config.in.

if RV_TARGET_HELLO_RV

config HELLO_RV_ENABLE_SMILE
	bool "enable print smile"
	default y
	help
	  Show how to transfer config value to CMakeLists.txt.

config RV_TARGET_HELLO_RV_EXTRA_PRINT_STRING
	string "extra print string"
	default ""
	help
	  Set the selfdefine string you wanna print

endif
```

## board/Config.in
```kconfig
menu "Board options"

choice
	prompt "Board Type"
	default RV_BOARD_1808
	help
	  rk board type, usually the name of chip

config RV_BOARD_1108
	bool "rv1108"

config RV_BOARD_1109
	bool "rv1109"

config RV_BOARD_1808
	bool "rk1808"

config RV_BOARD_3326
	bool "rk3326"

endchoice

config RV_BOARD_TYPE
	string
	default "rv1108" if RV_BOARD_1108
	default "rv1109" if RV_BOARD_1109
	default "rk1808" if RV_BOARD_1808
	default "rk3326" if RV_BOARD_3326
	help
	  rv1108, rv1109, rk1808, rk3326

config RV_BOARD_VERSION
	string "board version"
	default "$(RV_BOARD_TYPE)-evb-linux"
	default "rv1108-minievb-v10" if RV_BOARD_1108
	help
	  This must be the same name of dts file under kernel

source "board/rv1108/Config.in"

endmenu
```

## board/rk1808/buildroot_config/configs/rk1808_linaro_aarch64_defconfig
```kconfig
BR2_aarch64=y
BR2_cortex_a35=y
# BR2_STRIP_strip is not set
# BR2_COMPILER_PARANOID_UNSAFE_PATH is not set
BR2_SSP_ALL=y
BR2_RELRO_PARTIAL=y
BR2_FORTIFY_SOURCE_2=y
BR2_TOOLCHAIN_EXTERNAL=y
BR2_TOOLCHAIN_EXTERNAL_GDB_SERVER_COPY=y
BR2_TARGET_GENERIC_HOSTNAME="rk1808"
BR2_TARGET_GENERIC_ISSUE="Welcome to rk1808"
# BR2_TARGET_ENABLE_ROOT_LOGIN is not set
# BR2_TARGET_GENERIC_GETTY is not set
# BR2_TARGET_GENERIC_REMOUNT_ROOTFS_RW is not set
BR2_TARGET_TZ_INFO=y
BR2_PACKAGE_BUSYBOX_CONFIG="$(TOPDIR)/../../board/rk1808/buildroot_config/busybox.config"
BR2_PACKAGE_GPERF=y
BR2_PACKAGE_LIBDRM=y
# BR2_PACKAGE_IFUPDOWN_SCRIPTS is not set
BR2_PACKAGE_ANDROID_TOOLS=y
# BR2_TARGET_ROOTFS_TAR is not set
BR2_PACKAGE_HOST_CMAKE=y
BR2_PACKAGE_HOST_PKGCONF=y
BR2_PACKAGE_HOST_UTIL_LINUX=y
```

## board/rv1108/Config.in
```kconfig
config RV_BOARD_110X
	bool
	default y if RV_BOARD_1108 || RV_BOARD_1109
	default n

if RV_BOARD_110X

choice
	prompt "Product Type"
	default RV_PRODUCT_MIN_DEMO
	help
	  Select a product type to use.

config RV_PRODUCT_CVR
	bool "Car Video Recoder"
	depends on !RV_PCBA_ENABLE
	help
	  Product Type: Car video recorder.

config RV_PRODUCT_SDV
	bool "Sport DV"
	depends on !RV_PCBA_ENABLE
	help
	  Product Type: Sport DV.

config RV_PRODUCT_FACE
	bool "Face related products"
	depends on !RV_PCBA_ENABLE
	help
	  Product Type: Face related products.

config RV_PRODUCT_SIMPLE_DEMO
	bool "Simple demo with camera preview"
	help
	  Product Type: Camera preview.

config RV_PRODUCT_MIN_DEMO
	bool "Min demo, only busybox terminal"
	help
	  Product Type: Busybox terminal.

config RV_PRODUCT_IPC
	bool "IP Camera"
	depends on !RV_PCBA_ENABLE
	help
	  Product Type: IP Camera.
endchoice

config RV_PRODUCT_TYPE
	string
	default "SIMPLEDEMO"	if RV_PCBA_ENABLE
	default "CVR"        	if RV_PRODUCT_CVR
	default "SDV"        	if RV_PRODUCT_SDV
	default "IPC"        	if RV_PRODUCT_IPC
	default "FACE"       	if RV_PRODUCT_FACE
	default "SIMPLEDEMO"    if RV_PRODUCT_SAMPLE
	help
	  type: CVR/SDV/IPC/FACE/SIMPLEDEMO

config RV_LCD_RESOLUTION
	string "lcd resolution"
	default "960x540" if RV_BOARD_VERSION = "rv1108-evb-v13"
	default "1280x720" if RV_BOARD_VERSION = "rv1108-minievb-v10"
	default "0x0"
	depends on RV_BOARD_VERSION != ""
	help
	  pattern: widthxheight

config RV_LCD_BACKLIGHT_HIGH
	int "LCD backlight high value"
	default 250

config RV_LCD_BACKLIGHT_MEDIAN
	int "LCD backlight median value"
	default 200

config RV_LCD_BACKLIGHT_LOW
	int "LCD backlight low value"
	default 150

endif
```

## board/rv1108/buildroot_config/configs/rv1108_gcc6_uclibc_defconfig
```kconfig
BR2_arm=y
BR2_cortex_a7=y
BR2_ARM_FPU_NEON_VFPV4=y
# BR2_COMPILER_PARANOID_UNSAFE_PATH is not set
BR2_TOOLCHAIN_BUILDROOT_VENDOR="rv110x"
BR2_KERNEL_HEADERS_VERSION=y
BR2_DEFAULT_KERNEL_VERSION="3.10.104"
BR2_PACKAGE_HOST_LINUX_HEADERS_CUSTOM_3_10=y
BR2_UCLIBC_CONFIG="$(TOPDIR)/../../board/rv1108/buildroot_config/uClibc-ng.config"
BR2_TOOLCHAIN_BUILDROOT_WCHAR=y
BR2_PTHREAD_DEBUG=y
BR2_TOOLCHAIN_BUILDROOT_USE_SSP=y
BR2_TOOLCHAIN_BUILDROOT_CXX=y
BR2_GCC_ENABLE_LTO=y
BR2_TARGET_GENERIC_HOSTNAME="root"
BR2_TARGET_GENERIC_ISSUE="Welcome to rv110x"
# BR2_TARGET_ENABLE_ROOT_LOGIN is not set
# BR2_TARGET_GENERIC_GETTY is not set
# BR2_TARGET_GENERIC_REMOUNT_ROOTFS_RW is not set
BR2_TARGET_TZ_INFO=y
BR2_PACKAGE_BUSYBOX_CONFIG="$(TOPDIR)/../../board/rv1108/buildroot_config/busybox.config"
# BR2_PACKAGE_IFUPDOWN_SCRIPTS is not set
BR2_TARGET_ROOTFS_SQUASHFS=y
# BR2_TARGET_ROOTFS_TAR is not set
BR2_PACKAGE_HOST_CMAKE=y
BR2_PACKAGE_HOST_PKGCONF=y
```

## buildroot/Config.in
```kconfig
menu Buildroot

config BUILDROOT_CONFIG_FILE
	string "Location to save buildroot config"
	default "$(BOARD_DIR)/$(RV_BOARD_TYPE)/buildroot_config/configs/defconfig"
	help
		 When running 'make buildroot-savedefconfig', the defconfig file will be
		 saved in this location.
		 Make value start with '$(BOARD_DIR)/$(RV_BOARD_TYPE)/buildroot_config/configs/'.

config BUILDROOT_ENABLE_LIBDRM
	bool "enable libdrm"

endmenu
```

## kernel/Config.in
```kconfig
menu "kernel"

config KERNEL_DEFCONFIG
	string "kernel defconfig"
	default "$(RV_BOARD_TYPE)_defconfig"

config KERNEL_DTS_NAME
	string "kernel dts name"
	default "$(RV_BOARD_VERSION)"

config RV_TARGET_KERNEL_INITRAMFS
	string "config of CONFIG_INITRAMFS_SOURCE"
	default ""
	help
	  recovery: app/recovery/mini_system

comment "Debug: Convenience for some debugging setting."

config RV_TARGET_KERNEL_MEMORY_SIZE
	string "total memory size"
	default ""
	help
	  8bytes hexadecimal start with 0x;
	  CVR default 0x08000000;
	  SDV default 0x10000000;

config RV_TARGET_KERNEL_ION_SIZE
	string "ion memory size"
	default ""
	help
	  8bytes hexadecimal start with 0x
	  CVR default 0x04400000;
	  SDV default 0x0a000000;

config RV_TARGET_KERNEL_ACLK_RKVENC_PRE
	string "aclk value of rkvenc pre"
	default ""
	help
	  decimal value, default 300000000

config RV_TARGET_KERNEL_CLK_VENC_CORE
	string "clk value of venc core"
	default ""
	help
	  decimal value, default 300000000

config RV_TARGET_KERNEL_ACLK_RKVDEC_PRE
	string "aclk value of rkvdec pre"
	default ""
	help
	  decimal value, default 300000000

config RV_TARGET_KERNEL_ACLK_VPU_PRE
	string "aclk value of vpu pre"
	default ""
	help
	  decimal value, default 300000000

config RV_TARGET_KERNEL_CLK_RGA
	string "clk value of rga"
	default ""
	help
	  decimal value, default 300000000

endmenu
```
